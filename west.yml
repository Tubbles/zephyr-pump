## west.yml
```yaml
# Single source of truth for which Zephyr (and modules) this project builds
# against. Bump `revision`, rebuild the image, done. This repo is itself the
# manifest repo (Zephyr "T2 / star topology" application).
manifest:
  remotes:
    - name: zephyrproject-rtos
      url-base: https://github.com/zephyrproject-rtos
  projects:
    - name: zephyr
      remote: zephyrproject-rtos
      revision: v4.4.1
      # ESP32-C6 (XIAO) support is in-tree EXCEPT a few modules we allowlist
      # below; importing Zephyr's full manifest would also pull the ~40 other
      # HAL/fatfs/mbedTLS repos we don't need. west fetches each allowlisted
      # module at the revision Zephyr pins for v4.4.1:
      #   - hal_espressif: the Espressif HAL, the ESP 2nd-stage (simple-boot)
      #     bootloader support, and the WiFi/BT binary blobs.
      #   - mcuboot: the MCUboot secondary bootloader. Needed for OTA / A-B slot
      #     swapping; sysbuild builds it alongside the app. A plain simple-boot
      #     build does not use it, but fetching is harmless when unused.
      # picolibc still comes from the SDK toolchain
      # (CONFIG_PICOLIBC_USE_TOOLCHAIN), so nothing else is needed. Importing
      # Zephyr's manifest also registers its build/flash west extension commands,
      # so the standalone `west-commands:` line is gone. Do NOT use an empty
      # allowlist to mean "no modules": west reads `[]` as "no filter" and
      # imports everything. To add another module, append its name below.
      import:
        name-allowlist:
          - hal_espressif
          - mcuboot
          # WiFi crypto stack: the ESP32 WiFi driver selects MBEDTLS +
          # PSA_CRYPTO, and mbedtls's CMakeLists does add_subdirectory(
          # tf-psa-crypto), which fails to configure until that split-out repo
          # is also fetched. Both are required by CONFIG_WIFI in app/prj.conf.
          - mbedtls
          - tf-psa-crypto
  self:
    # The workspace topdir is the repo root; `make update` copies this file
    # into a generated, gitignored `.manifest/` git repo and runs
    # `west init -l .manifest`, so the checkouts (zephyr/, modules/, ...) land
    # alongside it under the repo. This path is relative to that topdir.
    path: .manifest
```
